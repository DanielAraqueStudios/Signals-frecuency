/*
 * PARTS_SORTING_PLATFORM - ESP32-S3 result display
 *
 * Target: ESP32-S3 (Arduino-ESP32 core), used as the MQTT/TLS endpoint of
 * the parts-sorting pipeline. This board does NOT run the classifier and
 * does NOT take the photo -- a worker's phone captures the part image and
 * uploads it separately (HTTPS, api-gateway). This sketch's only job:
 *
 *   1. Connect to WiFi.
 *   2. Connect to the MQTT broker over TLS (MQTTS, port 8883).
 *   3. Subscribe to this device's own result topic, results/<MQTT_USERNAME>
 *      (see ../../mqtt-broker/README.md "Topic scheme" -- the topic
 *      segment IS the device's MQTT username, minted by api-gateway's
 *      POST /devices/pair as device-<deviceId>; do not invent another
 *      topic shape here).
 *   4. Parse each incoming JSON result and print a formatted line to
 *      Serial (plus an optional SSD1306 OLED), keeping a running
 *      per-label count.
 *
 * No physical sorting/actuation in this version -- identification/logging
 * only, confirmed with the user. No camera on this board for this project.
 *
 * Board package required: Arduino-ESP32 core **3.x** (see
 * ../../../LAB_TESTING/LAB1/firmware/README.md for the same requirement
 * elsewhere in this repo -- core 2.x vs 3.x changed several APIs
 * incompatibly). This sketch is I/O-driven, not sampling-driven, so it
 * does not use the hardware-timer API at all; periodic work (MQTT
 * reconnect checks) uses millis()-based non-blocking timing instead,
 * which needs no core-version-specific API.
 *
 * NOT verified on real hardware or compiled with the Arduino IDE /
 * arduino-cli in this environment -- see README.md "What could not be
 * verified" for exactly what that means and what to check first.
 */

#include <WiFi.h>
#include <WiFiClientSecure.h>
#include <PubSubClient.h>
#include <ArduinoJson.h>

// ---------------------------------------------------------------------
// EDIT THIS: WiFi credentials
// ---------------------------------------------------------------------
#define WIFI_SSID "EDIT_THIS_WIFI_SSID"
#define WIFI_PASSWORD "EDIT_THIS_WIFI_PASSWORD"

// ---------------------------------------------------------------------
// EDIT THIS: MQTT broker + this device's credentials
//
// MQTT_USERNAME must be exactly the device login name issued by
// api-gateway's POST /devices/pair (device-<deviceId>) -- it is also the
// topic segment this sketch subscribes to below. For local dev, use the
// username/password created by mqtt-broker/README.md's
// `mosquitto_passwd -b ... device-deviceABC devpassword2` step.
// ---------------------------------------------------------------------
#define MQTT_HOST "EDIT_THIS_MQTT_BROKER_HOST"
#define MQTT_PORT 8883
#define MQTT_USERNAME "EDIT_THIS_device-deviceABC"
#define MQTT_PASSWORD "EDIT_THIS_MQTT_PASSWORD"

// ---------------------------------------------------------------------
// EDIT THIS: broker CA certificate (PEM), used by WiFiClientSecure to
// verify the broker's TLS server certificate.
//
// Dev: paste the contents of
//   PARTS_SORTING_PLATFORM/mqtt-broker/certs/ca.crt
// generated by ../../scripts/gen-dev-certs.sh.
// Production: paste the real CA cert issued for the production broker
// (or the public CA chain, if it uses a publicly-trusted certificate).
// ---------------------------------------------------------------------
static const char MQTT_CA_CERT[] PROGMEM = R"EOF(
-----BEGIN CERTIFICATE-----
EDIT_THIS_PASTE_CA_CERT_PEM_HERE
-----END CERTIFICATE-----
)EOF";

// ---------------------------------------------------------------------
// Optional OLED (SSD1306 over I2C). Leave HAS_OLED undefined to run
// Serial-only (the default/required path) -- must compile fine either
// way.
// ---------------------------------------------------------------------
// #define HAS_OLED

#ifdef HAS_OLED
#include <Wire.h>
#include <Adafruit_GFX.h>
#include <Adafruit_SSD1306.h>
#define OLED_WIDTH 128
#define OLED_HEIGHT 64
#define OLED_I2C_ADDRESS 0x3C
Adafruit_SSD1306 oled(OLED_WIDTH, OLED_HEIGHT, &Wire, -1);
#endif

// ---------------------------------------------------------------------
// Running per-label counts. A small fixed-size table is enough here --
// the label set is small and known (bolt, screw, nut, washer, ...) and
// classification-service can also send "unclassified" (stub mode).
// ---------------------------------------------------------------------
#define MAX_LABELS 16
struct LabelCount {
  char label[24];
  uint32_t count;
};
LabelCount labelCounts[MAX_LABELS];
uint8_t labelCountsUsed = 0;

WiFiClientSecure tlsClient;
PubSubClient mqttClient(tlsClient);

// Non-blocking reconnect timing (no hardware timer needed -- this
// sketch is I/O-driven, not sampling-driven; see file header).
unsigned long lastReconnectAttemptMs = 0;
const unsigned long RECONNECT_INTERVAL_MS = 5000;

char resultTopic[64];

void connectWiFi() {
  Serial.print("WiFi: connecting to ");
  Serial.println(WIFI_SSID);
  WiFi.mode(WIFI_STA);
  WiFi.begin(WIFI_SSID, WIFI_PASSWORD);
  while (WiFi.status() != WL_CONNECTED) {
    delay(500);
    Serial.print(".");
  }
  Serial.println();
  Serial.print("WiFi: connected, IP=");
  Serial.println(WiFi.localIP());
}

void bumpLabelCount(const char *label) {
  for (uint8_t i = 0; i < labelCountsUsed; i++) {
    if (strncmp(labelCounts[i].label, label, sizeof(labelCounts[i].label)) == 0) {
      labelCounts[i].count++;
      return;
    }
  }
  if (labelCountsUsed < MAX_LABELS) {
    strncpy(labelCounts[labelCountsUsed].label, label, sizeof(labelCounts[labelCountsUsed].label) - 1);
    labelCounts[labelCountsUsed].label[sizeof(labelCounts[labelCountsUsed].label) - 1] = '\0';
    labelCounts[labelCountsUsed].count = 1;
    labelCountsUsed++;
  } else {
    Serial.println("WARN: label count table full, dropping new label from counts");
  }
}

void printLabelCounts() {
  Serial.println("--- running counts ---");
  for (uint8_t i = 0; i < labelCountsUsed; i++) {
    Serial.print("  ");
    Serial.print(labelCounts[i].label);
    Serial.print(": ");
    Serial.println(labelCounts[i].count);
  }
  Serial.println("-----------------------");
}

#ifdef HAS_OLED
void showOnOled(const char *line1, const char *line2) {
  oled.clearDisplay();
  oled.setCursor(0, 0);
  oled.println(line1);
  oled.println(line2);
  oled.display();
}
#endif

// Called from loop() only -- never from an interrupt context. This
// sketch has no ISR at all, but the same discipline used in
// LAB_TESTING/LAB1/firmware (no blocking I/O from an ISR) applies to
// any future addition: keep Serial/MQTT/display work here.
void handleMessage(char *topic, byte *payload, unsigned int length) {
  // ArduinoJson needs a null-terminated buffer; payload isn't.
  static char jsonBuf[512];
  if (length >= sizeof(jsonBuf)) {
    Serial.println("WARN: MQTT payload too large for jsonBuf, dropping");
    return;
  }
  memcpy(jsonBuf, payload, length);
  jsonBuf[length] = '\0';

  StaticJsonDocument<512> doc;
  DeserializationError err = deserializeJson(doc, jsonBuf);
  if (err) {
    Serial.print("WARN: JSON parse failed: ");
    Serial.println(err.c_str());
    return;
  }

  const char *label = doc["label"] | "unknown";
  bool isStub = doc["stub"] | false;
  bool hasConfidence = doc.containsKey("confidence");
  float confidence = doc["confidence"] | 0.0f;

  char line[64];
  if (isStub) {
    snprintf(line, sizeof(line), "STUB: %s", label);
  } else if (hasConfidence) {
    snprintf(line, sizeof(line), "%s (%.0f%%)", label, confidence * 100.0f);
  } else {
    snprintf(line, sizeof(line), "%s", label);
  }

  Serial.print("Result: ");
  Serial.println(line);

  bumpLabelCount(label);
  printLabelCounts();

#ifdef HAS_OLED
  char countLine[32];
  snprintf(countLine, sizeof(countLine), "count: see Serial");
  showOnOled(line, countLine);
#endif
}

bool connectMqtt() {
  Serial.print("MQTT: connecting to ");
  Serial.print(MQTT_HOST);
  Serial.print(":");
  Serial.println(MQTT_PORT);

  // Client ID does not need to be secret; username/password carry the
  // real auth. Reuse the MQTT username so broker logs are easy to read.
  if (mqttClient.connect(MQTT_USERNAME, MQTT_USERNAME, MQTT_PASSWORD)) {
    Serial.println("MQTT: connected");
    if (mqttClient.subscribe(resultTopic)) {
      Serial.print("MQTT: subscribed to ");
      Serial.println(resultTopic);
    } else {
      Serial.println("WARN: MQTT subscribe failed");
    }
    return true;
  }

  Serial.print("WARN: MQTT connect failed, state=");
  Serial.println(mqttClient.state());
  return false;
}

void setup() {
  Serial.begin(115200);
  delay(200);
  Serial.println();
  Serial.println("ESP32-S3 result display starting...");

  snprintf(resultTopic, sizeof(resultTopic), "results/%s", MQTT_USERNAME);

#ifdef HAS_OLED
  Wire.begin();
  if (!oled.begin(SSD1306_SWITCHCAPVCC, OLED_I2C_ADDRESS)) {
    Serial.println("WARN: SSD1306 OLED not found, continuing Serial-only");
  } else {
    oled.clearDisplay();
    oled.setTextSize(1);
    oled.setTextColor(SSD1306_WHITE);
    oled.setCursor(0, 0);
    oled.println("Starting...");
    oled.display();
  }
#endif

  connectWiFi();

  tlsClient.setCACert(MQTT_CA_CERT);
  mqttClient.setServer(MQTT_HOST, MQTT_PORT);
  mqttClient.setCallback(handleMessage);

  // PubSubClient's default MQTT packet buffer is 256 bytes, which is
  // often too small for a JSON result payload (label + confidence +
  // stub flag + any future fields) and silently fails to deliver
  // messages that exceed it -- no error, the callback just never fires.
  // Bump it explicitly; must be called before the first connect.
  mqttClient.setBufferSize(512);

  connectMqtt();
}

void loop() {
  if (WiFi.status() != WL_CONNECTED) {
    Serial.println("WiFi: connection lost, reconnecting...");
    connectWiFi();
  }

  if (!mqttClient.connected()) {
    unsigned long now = millis();
    if (now - lastReconnectAttemptMs >= RECONNECT_INTERVAL_MS) {
      lastReconnectAttemptMs = now;
      connectMqtt();
    }
  } else {
    mqttClient.loop();
  }
}
